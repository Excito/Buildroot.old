## board/excito/bubbatwo/image.its
```
/dts-v1/;


/ {
	description = "BUBBATWO install image";
	#address-cells = <1>;

	images {
		kernel@1 {
			description = "bubbatwo-3.1.4";
			data = /incbin/("./vmlinux.bin.gz");
			type = "kernel";
			arch = "ppc";
			os = "linux";
			compression = "gzip";
			load = <00000000>;
			entry = <00000000>;
			hash@1 {
				algo = "md5";
			};
			hash@2 {
				algo = "sha1";
			};
		};

		ramdisk@1 {
			description = "Excito installer";
			data = /incbin/("./rootfs.ext2.gz");
			type = "ramdisk";
			arch = "ppc";
			os = "linux";
			load = <00300000>;
			compression = "gzip";
			hash@1 {
				algo = "sha1";
			};
		};

		fdt@1 {
			description = "bubba-fdt";
			data = /incbin/("./bubba.dtb");
			type = "flat_dt";
			arch = "ppc";
			compression = "none";
			hash@1 {
				algo = "crc32";
			};
		};
	};

	configurations {
		default = "config@1";

		config@1 {
			description = "Excito BUBBATWO installer";
			kernel = "kernel@1";
			ramdisk = "ramdisk@1";
			fdt = "fdt@1";
		};
	};
};
```

## configs/bubbatwo_defconfig
```kconfig
BR2_powerpc=y
BR2_powerpc_e300c3=y
BR2_JLEVEL=4
BR2_CCACHE=y
BR2_DEPRECATED=y
BR2_GCC_VERSION_4_4_X=y
BR2_ENABLE_LOCALE_PURGE=y
BR2_TOOLCHAIN_BUILDROOT_LARGEFILE=y
BR2_TOOLCHAIN_BUILDROOT_WCHAR=y
BR2_TOOLCHAIN_BUILDROOT_CXX=y
BR2_ROOTFS_DEVICE_CREATION_DYNAMIC_UDEV=y
BR2_ROOTFS_POST_BUILD_SCRIPT="board/excito/bubbatwo/postbuild.sh"
BR2_PACKAGE_BUSYBOX_SHOW_OTHERS=y
BR2_PACKAGE_CUSTOMIZE=y
BR2_PACKAGE_E2FSPROGS=y
BR2_PACKAGE_LVM2=y
BR2_TARGET_ROOTFS_EXT2=y
BR2_TARGET_ROOTFS_EXT2_GZIP=y
# BR2_TARGET_ROOTFS_TAR is not set
BR2_LINUX_KERNEL=y
BR2_LINUX_KERNEL_PATCH="board/excito/bubbatwo/patches"
BR2_LINUX_KERNEL_USE_CUSTOM_CONFIG=y
BR2_LINUX_KERNEL_CUSTOM_CONFIG_FILE="board/excito/bubbatwo/linux-3.1.4.config"
```
